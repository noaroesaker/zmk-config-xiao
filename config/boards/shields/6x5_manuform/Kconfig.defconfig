## config/boards/shields/6x5_manuform/Kconfig.defconfig
```kconfig
if SHIELD_CORNEXIAO_LEFT

config ZMK_KEYBOARD_NAME
    default "CorneXiao"

config ZMK_SPLIT_ROLE_CENTRAL
    default y

endif

if SHIELD_CORNEXIAO

config ZMK_SPLIT
    default y

endif
```

## config/boards/shields/6x5_manuform/Kconfig.shield
```kconfig
config SHIELD_CORNEXIAO
    bool

config SHIELD_CORNEXIAO_LEFT
    def_bool $(shields_list_contains,cornexiao_left)
    select SHIELD_CORNEXIAO

config SHIELD_CORNEXIAO_RIGHT
    def_bool $(shields_list_contains,cornexiao_right)
    select SHIELD_CORNEXIAO
```

## config/boards/shields/cornexiao/Kconfig.shield
```kconfig
config SHIELD_CORNEXIAO_LEFT
    def_bool $(shields_list_contains,cornexiao_left)

config SHIELD_CORNEXIAO_RIGHT
    def_bool $(shields_list_contains,cornexiao_right)
```
